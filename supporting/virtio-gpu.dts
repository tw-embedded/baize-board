/dts-v1/;

/ {
	passthrough {
		compatible = "simple-bus";
		#address-cells = <2>;
		#size-cells = <2>;
		ranges;

		to_android {
			compatible = "dtb-passthrough-test";
			status = "ok";
			string = "pass";
		};

			virtio_mmio@20002c00 {
				/* dma-coherent; */
				interrupts = <0x0 0x18 0x1>;
				reg = <0x0 0x20002c00 0x0 0x200>;
				compatible = "virtio,mmio";
				status = "okay";
			};
	};
};
